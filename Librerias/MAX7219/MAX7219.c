/*
 * MAX7219.c
 *
 * @brief Implementación de la librería para el control de una matriz de LEDs usando MAX7219 en STM32 mediante SPI.
 *
 * @author Daniel Ruiz
 * @date Jan 4, 2025
 * @version 1.0
 */

#include "MAX7219.h"

static SPI_HandleTypeDef* MAX7219_hspi; /**< Manejador de la interfaz SPI utilizada para cominucarse con el módulo*/

uint8_t bufferCol[NUM_DEV*8] = {0};

/**
 * @brief Inicializa la matriz de LEDs.
 * 
 * @param hspi Puntero al manejador de la interfaz SPI utilizada para comunicarse con el módulo.
 * 
 * Configura los registros del MAX7219 para preparar la matriz de LEDs para su uso.
 */
void MAX7219_Init(SPI_HandleTypeDef* hspi)
{
    // Asigna el handler de SPI proporcionado a la variable estática
    MAX7219_hspi = hspi;

    max7219_cmd(0x09, 0);    // Sin decodificación (modo gráfico)
    max7219_cmd(0x0A, 0x01); // Intensidad de brillo en 3/32
    max7219_cmd(0x0B, 0x07); // Escaneo de las 8 columnas
    max7219_cmd(0x0C, 0x01); // Modo operación normal
    max7219_cmd(0x0F, 0);    // Deshabilitar test de display
}

/**
 * @brief Escribe un byte de datos en una fila específica de la matriz de LEDs.
 * 
 * @param row La fila en la que se escribirá el dato (1-8).
 * @param data El byte de datos que se escribirá en la fila.
 */
void max7219_write(int row, uint8_t data)
{
    int devTarget = (row - 1) / 8;  // Determina en qué MAX7219 se escribirá el dato
    int offset = devTarget * 8;     // Calcula el offset de la fila en el buffer
    uint16_t writeData = 0;

    HAL_GPIO_WritePin(CS_GPIO_Port, CS_Pin, 0);  // Habilitar el esclavo
    for (int dev = 0; dev < NUM_DEV; dev++)
    {
        if (dev == devTarget)
        {
            writeData = ((row - offset) << 8) | data;  // Enviar número de fila y datos
            HAL_SPI_Transmit(MAX7219_hspi, (uint8_t *)&writeData, 1, 1000);
        }
        else
        {
            writeData = 0;  // No operación en los otros dispositivos
            HAL_SPI_Transmit(MAX7219_hspi, (uint8_t *)&writeData, 1, 1000);
        }
    }
    HAL_GPIO_WritePin(CS_GPIO_Port, CS_Pin, 1);  // Deshabilitar el esclavo
}

/**
 * @brief Envía un comando al MAX7219.
 * 
 * @param Addr Dirección del registro del MAX7219.
 * @param data Dato que se escribirá en el registro.
 */
void max7219_cmd(uint8_t Addr, uint8_t data)
{
    uint16_t writeData = (Addr << 8) | data;
    HAL_GPIO_WritePin(CS_GPIO_Port, CS_Pin, 0);
    for (int i = 0; i < NUM_DEV; i++)
    {
        HAL_SPI_Transmit(MAX7219_hspi, (uint8_t *)&writeData, 1, 100);
    }
    HAL_GPIO_WritePin(CS_GPIO_Port, CS_Pin, 1);
}

/**
 * @brief Limpia el buffer de la matriz de LEDs y actualiza la pantalla.
 */
void flushBuffer(void)
{
    uint8_t bufferRow[NUM_DEV * 8] = {0};

    // Convertir columnas en filas
    for (int i = 0; i < NUM_DEV * 8; i++)
    {
        int dev = i / 8;
        for (int j = 0; j < 8; j++)
        {
            if (bufferCol[i] & (1 << j))
            {
                bufferRow[j + (8 * dev)] |= (1 << (7 - (i - (8 * dev))));
            }
        }
    }

    for (int row = 1; row <= (NUM_DEV * 8); row++)
    {
        max7219_write(row, bufferRow[row - 1]);
    }
}

/**
 * @brief Apaga todos los LEDs de la matriz.
 */
void MAX7219_clearDisplay(void)
{
    for (int i = 0; i < NUM_DEV * 8; i++)
    {
        bufferCol[i] = 0;
    }
    flushBuffer();
}

/**
 * @brief Desplaza el contenido de la matriz hacia la izquierda.
 */
void shiftLeft(void)
{
    for (int cnt = NUM_DEV * 8 - 2; cnt >= 0; cnt--)
    {
        bufferCol[cnt + 1] = bufferCol[cnt];
    }
    bufferCol[0] = 0;
    flushBuffer();
}

/**
 * @brief Desplaza el contenido de la matriz hacia la derecha.
 */
void shiftRight(void)
{
    for (int cnt = 0; cnt < NUM_DEV * 8 - 1; cnt++)
    {
        bufferCol[cnt] = bufferCol[cnt + 1];
    }
    bufferCol[NUM_DEV * 8 - 1] = 0;
    flushBuffer();
}

/**
 * @brief Desplaza un carácter a través de la matriz de LEDs con un retardo específico.
 * 
 * Convierte un carácter en su representación de bits y lo desplaza a través de la matriz
 * de LEDs, mostrando el efecto de desplazamiento con un retardo configurable.
 * 
 * @param ch Carácter que se desplazará.
 * @param delay Retardo entre cada desplazamiento en milisegundos.
 */
void shiftchar(uint8_t ch, int delay)
{
    int indx = 0;
    for (int i = 0; i < FONT_WIDTH - 1; i++)  // Iterar sobre los bytes de la fuente de caracteres
    {
        uint8_t data = 0;
        
        // Invertir el orden de los bits
        for (int j = 7; j >= 0; j--)  // Extraer bits de cada byte
        {
            if ((MAX7219_Dot_Matrix_font[ch][indx]) & (1 << j))  // Si el bit es 1
            {
                data |= (1 << (7 - j));  // Escribirlo desde el bit 0 de 'data'
            }
        }
        
        bufferCol[0] = data;  // Almacenar el byte modificado en la primera posición del buffer
        flushBuffer();  // Actualizar la pantalla con el nuevo dato
        shiftLeft();  // Desplazar la imagen a la izquierda
        indx++;
        HAL_Delay(delay);  // Esperar el tiempo especificado antes del siguiente desplazamiento
    }
}

/**
 * @brief Muestra una cadena de caracteres en la matriz de LEDs con desplazamiento.
 * 
 * @param str Cadena de caracteres a mostrar.
 * @param delay Tiempo de retardo entre cada desplazamiento.
 */
void MAX7219_scrollString(char *str, int delay)
{
    while (*str)
    {
        shiftchar(*str, delay);
        str++;
    }
}

/**
 * @brief Muestra una cadena de caracteres en la matriz de LEDs.
 * 
 * Esta función toma una cadena de texto y la convierte en una representación de bytes
 * para visualizarla en la matriz de LEDs. Cada carácter se almacena en el buffer de
 * columnas y se muestra en la pantalla.
 * 
 * @param str Puntero a la cadena de caracteres que se mostrará.
 */
void MAX7219_printString(const char *str)
{
    int strindx = 0; // Índice de caracteres de la cadena de entrada
    for (int k = NUM_DEV * 8 - 1; k >= 0; )
    {
        int indx = 0; // Índice dentro de la fuente de caracteres
        for (int i = 0; i < FONT_WIDTH - 1; i++)  // Iterar sobre los bytes de la fuente
        {
            uint8_t data = 0;
            
            // Invertir el orden de los bits
            for (int j = 7; j >= 0; j--)  // Extraer bits de cada byte
            {
                if ((MAX7219_Dot_Matrix_font[str[strindx]][indx]) & (1 << j))  // Si el bit es 1
                {
                    data |= (1 << (7 - j));  // Escribirlo desde el bit 0 de 'data'
                }
            }
            
            bufferCol[k--] = data;  // Almacenar el byte modificado en el buffer de columnas
            indx++;
        }
        strindx++;  // Moverse al siguiente carácter en la cadena
        if (str[strindx] == '\0') break; // Importante: detenerse al final de la cadena
    }
    flushBuffer(); // Actualizar la pantalla con el nuevo contenido
}

/**
 * @brief Conjunto de fuentes para la pantalla de matriz de puntos MAX7219.
 *
 * Este array contiene el conjunto de fuentes de 8x8 para la pantalla de matriz de puntos MAX7219.
 * Cada carácter está representado por un array de 8 bytes, donde cada byte representa
 * una fila del carácter.
 */
const uint8_t MAX7219_Dot_Matrix_font [256] [8] = {
  { 0x00, 0x00, 0x00, 0x00, 0x00, 0x00, 0x00, 0x00 }, // 0x00
  { 0x7E, 0x81, 0x95, 0xB1, 0xB1, 0x95, 0x81, 0x7E }, // 0x01
  { 0x7E, 0xFF, 0xEB, 0xCF, 0xCF, 0xEB, 0xFF, 0x7E }, // 0x02
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  { 0x00, 0x00, 0x00, 0x00, 0x00, 0x00, 0x00, 0x00 }, // 0xFF
};  //  end of MAX7219_Dot_Matrix_font

